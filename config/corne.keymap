// Copyright 2021 Manna Harbour
// https://github.com/manna-harbour/miryoku
//#define ZMK_POINTING_DEFAULT_MOVE_VAL 1500  // default: 600
//#define ZMK_POINTING_DEFAULT_SCRL_VAL 20    // default: 10

#include "../miryoku/custom_config.h"
#include "../miryoku/mapping/42/corne.h"
#include "../miryoku/miryoku.dtsi"
//#include <dt-bindings/zmk/pointing.h>

//&led_strip { chain-length = <27>; };
